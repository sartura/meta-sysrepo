## conf/layer.conf
```bitbake
# We have a conf and classes directory, add to BBPATH
BBPATH .= ":${LAYERDIR}"

# We have recipes-* directories, add to BBFILES
BBFILES += "${LAYERDIR}/recipes-*/*/*.bb \
	${LAYERDIR}/recipes-*/*/*.bbappend"

BBFILE_COLLECTIONS += "sysrepo"
BBFILE_PATTERN_sysrepo = "^${LAYERDIR}/"
BBFILE_PRIORITY_sysrepo = "7"

LAYERVERSION_sysrepo = "2"
LAYERDEPENDS_sysrepo = "openembedded-layer"
LAYERSERIES_COMPAT_sysrepo = "honister"
```
